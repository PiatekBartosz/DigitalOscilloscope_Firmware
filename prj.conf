## CMakeLists.txt
```
cmake_minimum_required(VERSION 3.13.1)

find_package(Zephyr REQUIRED HINTS $ENV{ZEPHYR_BASE})

project(app LANGUAGES C)

set(APP_SRC_PATH "src/app")

target_sources(
    app
    PRIVATE
    src/main.c
    ${APP_SRC_PATH}/app.c
    ${APP_SRC_PATH}/afe_manager/afe_manager.c
    ${APP_SRC_PATH}/app_shell/app_shell.c
    ${APP_SRC_PATH}/parallel_link/parallel_link.c
    ${APP_SRC_PATH}/tcp_server/tcp_server.c
)

target_include_directories(
    app
    PRIVATE
    ${APP_SRC_PATH}
)
```

## Kconfig
```
mainmenu "Digital Oscilloscope"

config PLINK_DEBUG
	bool "Parallel link debug verification"
	default n
	help
	  On startup, read the FPGA device ID register and verify it matches
	  the expected value (0x0ADC). Logs an error and returns -EIO if the
	  handshake fails.

config TCP_SERVER_LOG_LEVEL
	int "TCP server log level (0=off 1=err 2=wrn 3=inf 4=dbg)"
	default 3
	range 0 4
	help
	  Compile-time log level for the tcp_server module.
	  Set to 4 to see every command received over TCP.

config PARALLEL_LINK_LOG_LEVEL
	int "Parallel link log level (0=off 1=err 2=wrn 3=inf 4=dbg)"
	default 3
	range 0 4
	help
	  Compile-time log level for the parallel_link module.
	  Set to 4 to see STATUS polling and CTRL writes during acquisition.

config APP_LOG_LEVEL
	int "Application log level (0=off 1=err 2=wrn 3=inf 4=dbg)"
	default 3
	range 0 4
	help
	  Compile-time log level for the app module.

source "Kconfig.zephyr"
```

## prj.conf
```kconfig
# Base shell config
CONFIG_SERIAL=y
CONFIG_CONSOLE=y
CONFIG_UART_CONSOLE=y
CONFIG_SHELL=y
CONFIG_SHELL_PROMPT_UART="> "
CONFIG_PRINTK=y

# Logs
CONFIG_LOG=y
CONFIG_TCP_SERVER_LOG_LEVEL=4
CONFIG_PARALLEL_LINK_LOG_LEVEL=4
CONFIG_APP_LOG_LEVEL=4

# General
CONFIG_PICOLIBC=y
CONFIG_PICOLIBC_USE_MODULE=y
CONFIG_STACK_CANARIES=y
CONFIG_PRINTK=y

# Eth
CONFIG_NETWORKING=y
CONFIG_NET_L2_ETHERNET=y
CONFIG_NET_IPV4=y
CONFIG_NET_DHCPV4=y
CONFIG_NET_CONFIG_SETTINGS=y
CONFIG_NET_CONFIG_AUTO_INIT=y
CONFIG_NET_CONFIG_MY_IPV4_ADDR="192.168.0.111"
CONFIG_NET_CONFIG_MY_IPV4_NETMASK="255.255.255.0"
CONFIG_NET_CONFIG_MY_IPV4_GW="192.168.0.1"
CONFIG_ETH_STM32_HAL=y
CONFIG_NET_SHELL=y
CONFIG_NET_HOSTNAME_ENABLE=y
CONFIG_NET_HOSTNAME="oscilloscope"

# TCP sockets
CONFIG_NET_TCP=y
CONFIG_NET_SOCKETS=y
CONFIG_NET_SOCKETS_POLL_MAX=16
CONFIG_ZVFS_OPEN_MAX=16
CONFIG_NET_MAX_CONTEXTS=10

# mDNS / DNS-SD
CONFIG_MDNS_RESPONDER=y
CONFIG_DNS_SD=y

# Dac
CONFIG_DAC=y
CONFIG_DAC_SHELL=y
CONFIG_DAC_DAC61408=y

# GPIO
CONFIG_GPIO=y

CONFIG_PLINK_DEBUG=y

# Stack sizes — heavy network stack needs headroom
CONFIG_MAIN_STACK_SIZE=4096
CONFIG_SYSTEM_WORKQUEUE_STACK_SIZE=2048
CONFIG_NET_RX_STACK_SIZE=4096
CONFIG_NET_TX_STACK_SIZE=2048
CONFIG_SHELL_STACK_SIZE=4096

# Fault reporting is enabled in every build. Optimization policy lives in
# prj_release.conf and prj_debug.conf so Makefile targets select it explicitly.
CONFIG_FAULT_DUMP=2
CONFIG_THREAD_STACK_INFO=y
```

## src/main.c
```c
#include "app/app.h"
#include <zephyr/kernel.h>

int main(void)
{
    printk("Hello world from oscilloscope project!\n");

    int ret = app_init();

    size_t counter = 0u;
    while (1)
    {
        printk("Fatal error %d. Waiting for reboot... %zu\n", ret, counter++);
        k_sleep(K_SECONDS(1));
    }

    return 0;
}
```
