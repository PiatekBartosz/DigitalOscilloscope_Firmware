## ext/boards/nucleo_h723zg_dev/board.yml
```yaml
board:
  name: nucleo_h723zg_dev
  full_name: Nucleo H723ZG
  vendor: st
  socs:
    - name: stm32h723xx
```

## ext/drivers/dac/Kconfig.dac61408
```kconfig
config DAC_DAC61408
	bool "TI DAC_DAC61408 DAC driver"
	default y
	depends on DT_HAS_TI_DAC61408_ENABLED
	select SPI
	help
	  Enable the driver for the TI DAC_DAC61408.

if DAC_DAC61408

config DAC_DAC61408_INIT_PRIORITY
	int "Init priority"
	default 80
	help
	  TI DAC_DAC61408 DAC device driver initialization priority. Must be greater than SPI_INIT_PRIORITY.

endif # DAC_DAC61408
```

## ext/drivers/dac/Kconfig.dacx1408
```kconfig
config DAC_DACX1408
	bool "TI DACx1408 DAC driver"
	default y
	depends on DT_HAS_TI_DACX1408_ENABLED
	select I2C
	help
	  Enable the driver for the TI DACx1408.

if DAC_DACX1408

config DAC_DACX1408_INIT_PRIORITY
	int "Init priority"
	default 80
	help
	  TI DACx1408 DAC device driver initialization priority. Must be greater than I2C_INIT_PRIORITY.

endif # DAC_DACX1408
```

## ext/dts/bindings/dac/ti,dac61408.yaml
```yaml
description: "TI DAC61408"

compatible: "ti,dac61408"

include:
  - dac-controller.yaml
  - spi-device.yaml

properties:
  voltage-reference:
    type: int
    required: true
    description: "DAC voltage reference select"

  channel-gains:
      type: array
      required: true
      description: "Array of 8 channel gains (0..3)"

  "#io-channel-cells":
    const: 1

  clr-gpios:
    type: phandle-array
    description: |
      CLR input pin, active low.
    required: true

  reset-gpios:
    type: phandle-array
    description: |
      RESET input pin, active low.
    required: true
```

## ext/dts/bindings/dac/ti,dacx1408.yaml
```yaml
description: TI DACx1408 DAC controller

compatible: "ti,dacx1408"

include: dac-controller.yaml

properties:
  reg:
    required: true

  "#io-channel-cells":
    const: 1
```
